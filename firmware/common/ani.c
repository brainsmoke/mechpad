/*
 * Copyright (c) 2023 Erik Bosman <erik@minemu.org>
 *
 * Permission  is  hereby  granted,  free  of  charge,  to  any  person
 * obtaining  a copy  of  this  software  and  associated documentation
 * files (the "Software"),  to deal in the Software without restriction,
 * including  without  limitation  the  rights  to  use,  copy,  modify,
 * merge, publish, distribute, sublicense, and/or sell copies of the
 * Software,  and to permit persons to whom the Software is furnished to
 * do so, subject to the following conditions:
 *
 * The  above  copyright  notice  and this  permission  notice  shall be
 * included  in  all  copies  or  substantial portions  of the Software.
 *
 * THE SOFTWARE  IS  PROVIDED  "AS IS", WITHOUT WARRANTY  OF ANY KIND,
 * EXPRESS OR IMPLIED,  INCLUDING BUT NOT LIMITED TO THE WARRANTIES OF
 * MERCHANTABILITY,  FITNESS  FOR  A  PARTICULAR  PURPOSE  AND
 * NONINFRINGEMENT. IN NO EVENT SHALL THE AUTHORS OR COPYRIGHT HOLDERS
 * BE LIABLE FOR ANY CLAIM,  DAMAGES OR OTHER LIABILITY, WHETHER IN AN
 * ACTION OF CONTRACT,  TORT OR OTHERWISE,  ARISING FROM, OUT OF OR IN
 * CONNECTION  WITH THE SOFTWARE  OR THE USE  OR OTHER DEALINGS IN THE
 * SOFTWARE.
 *
 * (http://opensource.org/licenses/mit-license.html)
 *
 */

#include "ani.h"

/*
from math import tau, cos
max_val=0xff00
gamma=2.6

size = 256
wave = [ ( 1 - cos(x*tau/size) )/2 for x in range(size) ]

def clamp(x):
   return min(max_val, max(0, x))

table = [ clamp(int(max_val * x**gamma)) for x in wave ]

for i in range(0, size, 8):
    print ( '\t'+' '.join('0x{:04x},'.format(x) for x in table[i:i+8]) )

*/
static uint16_t wave[256] =
{
	0x0000, 0x0000, 0x0000, 0x0000, 0x0000, 0x0000, 0x0000, 0x0000,
	0x0000, 0x0000, 0x0001, 0x0001, 0x0003, 0x0004, 0x0006, 0x0009,
	0x000d, 0x0012, 0x0018, 0x0020, 0x0029, 0x0035, 0x0043, 0x0054,
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	0x0000, 0x0000, 0x0000, 0x0000, 0x0000, 0x0000, 0x0000, 0x0000,
};

static int state;

void prepare_next_frame(frame_t *f)
{

	static uint16_t n = 0;
	n+=1;

	int i;
	uint32_t b = n&7;
	uint32_t a = 8-b;
	uint32_t m = n>>3;
	switch (state)
	{
		case PARTY:
			for (i=0; i<N_LEDS; i++)
			{
				f->data[i*3+0] = ( a*wave[ (i*16+m)&0xff ] + b*wave[ (i*16+m+1)&0xff ] )>>4;
				f->data[i*3+1] = ( a*wave[ (i*16+m+85)&0xff ] + b*wave[ (i*16+m+86)&0xff ] )>>3;
				f->data[i*3+2] = ( a*wave[ (i*16+m+170)&0xff ] + b*wave[ (i*16+m+171)&0xff ] )>>4;
			}
			break;
		case SLEEP:
			m >>= 1;
			b = (n>>1)&7;
			a = 8-b;
			for (i=0; i<N_LEDS; i++)
			{
				f->data[i*3+0] = 0;
				f->data[i*3+1] = ( a*wave[ m&0xff ] + b*wave[ (m+1)&0xff ] )>>5;
				f->data[i*3+2] = 0;
			}
			break;
		case RED:
			for (i=0; i<N_LEDS; i++)
			{
				f->data[i*3+0] = 0;
				f->data[i*3+1] = ( a*wave[ (i*16+m)&0xff ] + b*wave[ (i*16+m+1)&0xff ] )>>3;
				f->data[i*3+2] = 0;
			}
			break;
		case GREEN:
			for (i=0; i<N_LEDS; i++)
			{
				f->data[i*3+0] = ( a*wave[ (i*16+m)&0xff ] + b*wave[ (i*16+m+1)&0xff ] )>>3;;
				f->data[i*3+1] = 0;
				f->data[i*3+2] = 0;
			}
			break;
		case BLUE:
			for (i=0; i<N_LEDS; i++)
			{
				f->data[i*3+0] = 0;
				f->data[i*3+1] = 0;
				f->data[i*3+2] = ( a*wave[ (i*16+m)&0xff ] + b*wave[ (i*16+m+1)&0xff ] )>>3;;
			}
			break;
		default:
			for (i=0; i<N_VALUES; i++)
				f->data[i] = 0;
			break;
	}
}

void set_animation(int s)
{
	state = s;
}

